## layers/meta-custom/conf/distro/poky-systemd.conf
```bitbake
# Poky + systemd

DISTRO_FEATURES:append = " usbhost systemd pam"

INIT_MANAGER = "systemd"

hostname:pn-base-files = "cups"

require conf/distro/poky.conf

DISTRO = "poky-systemd"
DISTROOVERRIDES = "poky"
```
